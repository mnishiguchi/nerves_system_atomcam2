## package/Config.in
```kconfig
source "$NERVES_DEFCONFIG_DIR/package/atomcam2-compat-headers/Config.in"
source "$NERVES_DEFCONFIG_DIR/package/atomcam2-vendor-compat-shim/Config.in"
```

## package/atomcam2-boot-announce/Config.in
```kconfig
config BR2_PACKAGE_ATOMCAM2_BOOT_ANNOUNCE
	bool "atomcam2-boot-announce"
	help
	  Install the prebuilt speaker playback tool (atomcam2-aoplay)
	  and the boot announcement sound used by the
	  atomcam2-boot-announce script when the vendor camera runtime
	  starts.
```

## package/atomcam2-camera/Config.in
```kconfig
config BR2_PACKAGE_ATOMCAM2_CAMERA
	bool "atomcam2-camera"
	help
	  Install the prebuilt native camera daemon (atomcam2-camd) that
	  drives the sensor through the vendor libimp and writes H.264
	  into the v4l2loopback device, replacing iCamera_app.
```

## package/atomcam2-compat-headers/Config.in
```kconfig
config BR2_PACKAGE_ATOMCAM2_COMPAT_HEADERS
	bool "Atom Cam 2 Linux 3.10 compatibility headers"
	help
	  Install compile-time compatibility definitions needed by target
	  dependencies when building against the Atom Cam 2 Linux 3.10 headers.
```

## package/atomcam2-first-ssh/Config.in
```kconfig
config BR2_PACKAGE_ATOMCAM2_FIRST_SSH
    bool "atomcam2 first ssh helpers"
    help
      Installs only the small helper scripts needed for the first Nerves MVP:
      load the AtomCam2 Wi-Fi driver if available, apply a simple hostname, and
      leave boot breadcrumbs for ping/SSH debugging.
```

## package/atomcam2-v4l2loopback/Config.in
```kconfig
config BR2_PACKAGE_ATOMCAM2_V4L2LOOPBACK
	bool "atomcam2-v4l2loopback"
	depends on BR2_LINUX_KERNEL
	help
	  Virtual V4L2 loopback devices, pinned to a revision that builds
	  against the Atom Cam 2 control kernel. The vendor camera runtime
	  writes already-encoded frames into these devices and the RTSP
	  server reads them, so no re-encoding is required.

	  https://github.com/umlaeute/v4l2loopback

comment "atomcam2-v4l2loopback needs a Linux kernel to be built"
	depends on !BR2_LINUX_KERNEL
```

## package/atomcam2-vendor-compat-shim/Config.in
```kconfig
config BR2_PACKAGE_ATOMCAM2_VENDOR_COMPAT_SHIM
	bool "Atom Cam 2 vendor compatibility shim"
	depends on BR2_mipsel
	help
	  Install a freestanding compatibility library that keeps the hardware
	  watchdog and raw SD storage under Nerves ownership while satisfying
	  the optional vendor runtime's narrow compatibility checks.
```

## package/atomcam2-video-hook/Config.in
```kconfig
config BR2_PACKAGE_ATOMCAM2_VIDEO_HOOK
	bool "atomcam2-video-hook"
	help
	  Install the preloaded library that mirrors the vendor camera
	  runtime's already-encoded frames into the v4l2loopback devices
	  so they can be published over RTSP without re-encoding.
```

## package/v4l2cpp/Config.in
```kconfig
config BR2_PACKAGE_V4L2CPP
	bool "v4l2cpp (atomcam2)"
	select BR2_PACKAGE_LOG4CPP
	depends on BR2_INSTALL_LIBSTDCPP
	help
	  C++ wrapper around the V4L2 API, used by v4l2rtspserver.

	  https://github.com/mpromonet/libv4l2cpp

comment "v4l2cpp needs a toolchain with C++ support"
	depends on !BR2_INSTALL_LIBSTDCPP
```

## package/v4l2rtspserver/Config.in
```kconfig
config BR2_PACKAGE_V4L2RTSPSERVER
	bool "v4l2rtspserver (atomcam2)"
	select BR2_PACKAGE_LIVE555
	select BR2_PACKAGE_V4L2CPP
	depends on BR2_INSTALL_LIBSTDCPP
	help
	  RTSP server for V4L2 devices. Publishes the already-encoded
	  frames that the vendor camera runtime writes into the
	  v4l2loopback devices, without re-encoding.

	  https://github.com/mpromonet/v4l2rtspserver

comment "v4l2rtspserver needs a toolchain with C++ support"
	depends on !BR2_INSTALL_LIBSTDCPP
```
